#include "forager.dtsi"

/ {
    // Split configuration for left peripheral
    split: split {
        compatible = "zmk,split";
        central-ble-address-offset = <0>;      // Central (dongle) = address 0
        peripheral-ble-address-offset = <1>;   // Left = address 1
    };
};

&kscan0 {
   col-gpios
   = <&gpio0 2 GPIO_ACTIVE_HIGH>
   , <&gpio0 3 GPIO_ACTIVE_HIGH>
   , <&gpio0 28 GPIO_ACTIVE_HIGH>
   , <&gpio0 29 GPIO_ACTIVE_HIGH>
   , <&gpio0 4 GPIO_ACTIVE_HIGH>
   ;

   row-gpios
   = <&gpio1 11 (GPIO_ACTIVE_HIGH | GPIO_PULL_DOWN)>
   , <&gpio1 13 (GPIO_ACTIVE_HIGH | GPIO_PULL_DOWN)>
   , <&gpio1 12 (GPIO_ACTIVE_HIGH | GPIO_PULL_DOWN)>
   , <&gpio1 14 (GPIO_ACTIVE_HIGH | GPIO_PULL_DOWN)>
   ;
};